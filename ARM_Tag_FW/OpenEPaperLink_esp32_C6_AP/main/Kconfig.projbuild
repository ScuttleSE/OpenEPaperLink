## ARM_Tag_FW/OpenEPaperLink_esp32_C6_AP/main/Kconfig.projbuild
```kconfig
menu "OEPL config"

  choice OEPL_HARDWARE_PROFILE
    prompt "Hardware profile"
    default OEPL_HARDWARE_PROFILE_DEFAULT

    config OEPL_HARDWARE_PROFILE_DEFAULT
      bool "Default"

    config OEPL_HARDWARE_PROFILE_POE_AP
      bool "PoE-AP"

    config OEPL_HARDWARE_PROFILE_CUSTOM
      bool "Custom"

    config OEPL_HARDWARE_PROFILE_LILYGO
      bool "LILYGO-AP"

    config OEPL_HARDWARE_PROFILE_4inch
      bool "4inchAP"
      
    config OEPL_HARDWARE_PROFILE_ELECROW_C6
      bool "ELECROW-C6-AP"

    config OEPL_HARDWARE_PROFILE_THREAD_BR
      bool "ESP Thread Border Router board"

  endchoice

  config OEPL_HARDWARE_UART_TX
    depends on OEPL_HARDWARE_PROFILE_CUSTOM
    int "GPIO - UART TX"
    default 3

  config OEPL_HARDWARE_UART_RX
    depends on OEPL_HARDWARE_PROFILE_CUSTOM
    int "GPIO - UART RX"
    default 2

  config OEPL_HARDWARE_UART_TX
    depends on OEPL_HARDWARE_PROFILE_4inch
    int "GPIO - UART TX"
    default 16

  config OEPL_HARDWARE_UART_RX
    depends on OEPL_HARDWARE_PROFILE_4inch
    int "GPIO - UART RX"
    default 17

  choice OEPL_HOST_LINK
    prompt "Host link"
    default OEPL_HOST_LINK_UART
    help
        How the radio talks to the host (the AP's ESP32, or a PC).

    config OEPL_HOST_LINK_UART
      bool "UART (GPIO pins of the hardware profile)"

    config OEPL_HOST_LINK_USB
      bool "Native USB (USB Serial/JTAG)"
      depends on SOC_USB_SERIAL_JTAG_SUPPORTED
      help
          The host link uses the chip's own USB port. The console must not use USB Serial/JTAG:
          build with sdkconfig.host-usb added to SDKCONFIG_DEFAULTS.

    config OEPL_HOST_LINK_WIFI
      bool "Wi-Fi (TCP server)"
      depends on SOC_WIFI_SUPPORTED
      help
          The host connects over TCP. Wi-Fi and 802.15.4 share the radio (coexistence).
          Build with sdkconfig.host-wifi added to SDKCONFIG_DEFAULTS.

  endchoice

  config OEPL_WIFI_SSID
    depends on OEPL_HOST_LINK_WIFI
    string "Wi-Fi SSID"
    default ""
    help
        Empty: use the credentials stored in NVS.

  config OEPL_WIFI_PASSWORD
    depends on OEPL_HOST_LINK_WIFI
    string "Wi-Fi password"
    default ""

  config OEPL_WIFI_HOSTNAME
    depends on OEPL_HOST_LINK_WIFI
    string "Hostname (mDNS)"
    default ""
    help
        Empty: oepl-hub-xxxx, from the last two bytes of the MAC.

  config OEPL_IMPROV_SERIAL
    depends on OEPL_HOST_LINK_WIFI
    bool "Improv Serial on the native USB port (Wi-Fi setup from the browser installer)"
    default y

  config OEPL_HUB_FW_VERSION
    depends on OEPL_HOST_LINK_WIFI
    string "Version string reported by Improv"
    default "dev"

  config OEPL_HOST_TCP_PORT
    depends on OEPL_HOST_LINK_WIFI
    int "TCP port for the host"
    default 6639

  config OEPL_SUBGIG_SUPPORT
    bool "Enable SubGhz Support"
    default "n"    

  menu "CC1101 Configuration" 
    depends on OEPL_SUBGIG_SUPPORT

    config GPIO_RANGE_MAX
            int
            default 33 if IDF_TARGET_ESP32
            default 46 if IDF_TARGET_ESP32S2
            default 48 if IDF_TARGET_ESP32S3
            default 18 if IDF_TARGET_ESP32C2
            default 19 if IDF_TARGET_ESP32C3
            default 30 if IDF_TARGET_ESP32C6
            default 30 if IDF_TARGET_ESP32H2

    config MISO_GPIO
            int "CC1101 MISO GPIO"
            range 0 GPIO_RANGE_MAX
            default 7
            help
                    Pin Number to be used as the MISO SPI signal.

    config SCK_GPIO
            int "CC1101 SCK GPIO"
            range 0 GPIO_RANGE_MAX
            default 0
            help
                    Pin Number to be used as the SCK SPI signal.

    config MOSI_GPIO
            int "CC1101 MOSI GPIO"
            default 1
            help
                    Pin Number to be used as the MOSI SPI signal.

    config CSN_GPIO
            int "CC1101 CSN GPIO"
            range 0 GPIO_RANGE_MAX
            default 4
            help
                    Pin Number to be used as the CSN SPI signal.

    config GDO0_GPIO
            int "CC1101 GDO0 GPIO"
            range 0 GPIO_RANGE_MAX
            default 5
            help
                    Pin Number to be used as the GDO0 signal.

    config GDO2_GPIO
            int "CC1101 GDO2 GPIO"
            range 0 GPIO_RANGE_MAX
            default 6
            help
                    Pin Number to be used as the GDO2 signal.

    choice SPI_HOST
            prompt "SPI peripheral that controls this bus"
            default SPI2_HOST
            help
                    Select SPI peripheral that controls this bus.
            config SPI2_HOST
                    bool "SPI2_HOST"
                    help
                            Use SPI2_HOST. This is also called HSPI_HOST.
            config SPI3_HOST
                    depends on IDF_TARGET_ESP32 || IDF_TARGET_ESP32S2 || IDF_TARGET_ESP32S3
                    bool "SPI3_HOST"
                    help
                            USE SPI3_HOST. This is also called VSPI_HOST
    endchoice
  endmenu

  config OEPL_DEBUG_PRINT
    bool "Enable OEPL Debug logging"
    default "n"    

  config OEPL_VERBOSE_DEBUG
    depends on OEPL_DEBUG_PRINT
    bool "Enable OEPL Verbose Debug logging"
    default "n"    

endmenu
```
